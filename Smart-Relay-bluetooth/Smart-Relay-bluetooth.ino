#include <Wire.h>
#include <Adafruit_GFX.h>
#include <Adafruit_SSD1306.h>
#include "RTClib.h"
#include <AutoTimer.h>
#include <EEPROM.h>>

#define SCREEN_WIDTH 128 // OLED display ancho en pixeles
#define SCREEN_HEIGHT 64 // OLED display alto en pixeles

//Direcciones de memoria de almacenamiento de datos
#define ADDRESS_HORA_ON 100
#define ADDRESS_MINUTO_ON 101
#define ADDRESS_HORA_OFF 102
#define ADDRESS_MINUTO_OFF 110

//Pines de entrada/salida
#define IZQUIERDA A3
#define DERECHA A0
#define MAS A1
#define MENOS A2
#define ACEPTAR 2
#define CANCELAR 3
#define RELAY 5

#define PAGINAS_TOTALES 3

#define HORA_ACTUAL 0
#define HORA_ON 1
#define HORA_OFF 2


#define OLED_RESET     4 // Reset pin # (or -1 if sharing Arduino reset pin)
Adafruit_SSD1306 display(SCREEN_WIDTH, SCREEN_HEIGHT, &Wire, OLED_RESET);
RTC_DS3231 RTC; //Declaramos un RTC basado en DS3231
unsigned long timerDelay = 0;

const unsigned char logo [] PROGMEM = {
  0x00, 0x00, 0x00, 0x00, 0x00, 0x00, 0x00, 0x00, 0x00, 0x00, 0x00, 0x00, 0x00, 0x00, 0x00, 0x00,
  0x00, 0x00, 0x00, 0x00, 0x00, 0x00, 0x00, 0x00, 0x00, 0x00, 0x00, 0x00, 0x00, 0x00, 0x00, 0x00,
  0x00, 0x00, 0x00, 0x00, 0x00, 0x00, 0x00, 0x00, 0x00, 0x00, 0x00, 0x00, 0x00, 0x00, 0x00, 0x00,
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  0x00, 0x00, 0x00, 0x00, 0x00, 0x00, 0x00, 0x00, 0x00, 0x00, 0x00, 0x00, 0x00, 0x00, 0x00, 0x00
};




void setup() {
  Serial.begin(9600); //Inicializamos el puerto serie
  Wire.begin(); //Inicializacmos la comunicación I2C
  if (!display.begin(SSD1306_SWITCHCAPVCC, 0x3C)) { // Inicializamos el display con ndirección 0x3C
    //Serial.println(F("SSD1306 NO SE PUDO ENCONTRAR"));
    for (;;); // Loop infinito
  }

  RTC.begin(); //Iniciamos el Reloj de tiempo Real
 
  //Asignación de entradas y salidas digitales
  pinMode(RELAY, OUTPUT);
  pinMode(IZQUIERDA, INPUT);
  pinMode(DERECHA, INPUT);
  pinMode(MAS, INPUT);
  pinMode(MENOS, INPUT);
  pinMode(ACEPTAR, INPUT);
  pinMode(CANCELAR, INPUT);

  digitalWrite(RELAY, LOW);

  // Limpiar pantalla
  display.clearDisplay();
  display.display();
  //Dibujamos el logo de TecnoIngenia
  display.clearDisplay();
  display.drawBitmap(0, 0, logo, 128, 64, 1); //Dibujar bitmap (posición x, posición y, Bitmap, ancho, largo, )
  display.display();

  Serial.write("A");
  delay(50);
  Serial.write("T");
  delay(50);
  Serial.println();
  delay(1000);
  Serial.print("AT+NAME:TecnoIngenia");
  Serial.println();
  delay(3000);

}

byte paginaActual = 0;

void loop() {
  botonera(); //Leemos los botones para cambio de páginas
  bluetooth();
  
  switch (paginaActual) { //Según la página en que nos encontremos dibujamos en pantalla
    case 0:
      pagina_0();
      break;
    case 1:
      pagina_1();
      break;
    case 2:
      pagina_2();
      break;
    case 3:
      pagina_3();
      break;
    default:
      pagina_0();
      break;
  }

  if (paginaActual != 3) { //Si no se está en modo manual se evalua si está dentro de horario con la función relayLoop()
    digitalWrite(RELAY, relayLoop());
  }

}


boolean izquierdaAnterior = false;
boolean derechaAnterior = false;


void botonera() {

  /* IZQUIERDA */
  if (digitalRead(IZQUIERDA) && !izquierdaAnterior) {
    if (paginaActual == 0) {
      paginaActual = PAGINAS_TOTALES;
    } else {
      paginaActual--;
    }
    izquierdaAnterior = true;
  } else if (!digitalRead(IZQUIERDA) && izquierdaAnterior) {
    izquierdaAnterior = false;
  }


  /* DERECHA */
  if (digitalRead(DERECHA) && !derechaAnterior) {
    paginaActual++;
    if (paginaActual > PAGINAS_TOTALES) {
      paginaActual = 0;
    }
    derechaAnterior = true;
  } else if (!digitalRead(DERECHA) && derechaAnterior) {
    derechaAnterior = false;
  }

  /* MÁS */

  /* MENOS */

  /* ACEPTAR */

  /* CANCELAR */

}

/*
   Está función muestra en pantalla la hora actual y permite modificarla al presionar OK por 10 segundos
*/
void pagina_0() {
  byte hora = RTC.now().hour();
  byte minuto = RTC.now().minute();

  display.clearDisplay();
  display.setTextSize(1.5);
  display.setTextColor(WHITE);
  display.setCursor(0, 0);
  display.print(F("       HORA ACTUAL"));

  modificarHora(hora, minuto, HORA_ACTUAL);
}

/*
   Está función muestra en pantalla la hora de encendido programada y permite modificarla al presionar OK por 10 segundos
*/
void pagina_1() {
  //Hora de Encendido de relay
  byte hora = EEPROM.read(ADDRESS_HORA_ON);
  byte minuto = EEPROM.read(ADDRESS_MINUTO_ON);


  display.clearDisplay();
  display.setTextSize(1.5);
  display.setTextColor(WHITE);
  display.setCursor(0, 0);
  display.print(F("    HORA ENCENDIDO"));

  modificarHora(hora, minuto, HORA_ON);

}

/*
   Está función muestra en pantalla la hora de apagado programada y permite modificarla al presionar OK por 10 segundos
*/
void pagina_2() {
  //Hora de apagado
  byte hora = EEPROM.read(ADDRESS_HORA_OFF);
  byte minuto = EEPROM.read(ADDRESS_MINUTO_OFF);


  display.clearDisplay();
  display.setTextSize(1.5);
  display.setTextColor(WHITE);
  display.setCursor(0, 0);
  display.print(F("     HORA APAGADO"));

  modificarHora(hora, minuto, HORA_OFF);
}

/*
   En está página se hace control manual del relevador
*/
void pagina_3() {
  if (digitalRead(ACEPTAR)) {
    digitalWrite(RELAY, HIGH);
  }
  if (digitalRead(CANCELAR)) {
    digitalWrite(RELAY, LOW);
  }

  display.clearDisplay();
  display.setTextSize(2);
  display.setTextColor(WHITE);
  display.setCursor(0, 0);
  display.print(F("   MANUAL"));

  display.setTextSize(3);
  if (digitalRead(RELAY)) {
    display.fillRect(0, 20, 60, 40, WHITE);
    display.drawRect(68, 20, 60, 40, WHITE);
  } else {
    display.drawRect(0, 20, 60, 40, WHITE);
    display.fillRect(68, 20, 60, 40, WHITE);
  }
  display.setTextColor(INVERSE);
  display.setCursor(10, 30);
  display.print(F("ON"));
  display.setCursor(70, 30);
  display.print(F("OFF"));
  display.display();

}


void printHora(byte hora, byte minuto) { //Imprime los datos de hor ay minutos en la pantalla

  display.setTextSize(4);
  display.setTextColor(WHITE);
  display.setCursor(0, 20);

  if (hora < 10) {
    display.print(F(" "));
  }
  display.print(hora);
  display.print(F(":"));
  if (minuto < 10) {
    display.print(F("0"));
  }
  display.print(minuto);

  display.display();
}

void modificarHora(byte hora, byte minuto, byte comand) { //Permite modificar la hora desplegada en pantalla y guardar los datos en la EEPROM
  int t = 0;

  printHora(hora, minuto);
  while (digitalRead(ACEPTAR)) {
    if (t > 25) {
      display.fillRect(0, 55, 40, 4, WHITE);
      display.display();
      while (digitalRead(ACEPTAR)) {}
      while (!digitalRead(ACEPTAR)) {
        display.clearDisplay();
        if (digitalRead(MAS)) {
          hora++;
          if (hora > 23) {
            hora = 0;
          }
        }
        if (digitalRead(MENOS)) {
          if (hora == 0) {
            hora = 23;
          } else {
            hora--;
          }
        }
        display.fillRect(0, 55, 45, 4, WHITE);
        printHora(hora, minuto);
        delay(200);
      }
      while (digitalRead(ACEPTAR)) {
        delay(100);
      }

      while (!digitalRead(ACEPTAR)) {
        display.clearDisplay();
        if (digitalRead(MAS)) {
          minuto++;
          if (minuto > 59) {
            minuto = 0;
          }
        }
        if (digitalRead(MENOS)) {
          if (minuto == 0) {
            minuto = 59;
          } else {
            minuto--;
          }
        }
        display.fillRect(70, 55, 45, 4, WHITE);
        printHora(hora, minuto);
        delay(100);
      }

      switch (comand) {
        case 0:
          RTC.adjust(DateTime(RTC.now().year(), RTC.now().month(), RTC.now().day(), hora, minuto, 0));
          break;
        case 1:
          EEPROM.write(ADDRESS_HORA_ON, hora);
          EEPROM.write(ADDRESS_MINUTO_ON, minuto);
          break;
        case 2:
          EEPROM.write(ADDRESS_HORA_OFF, hora);
          EEPROM.write(ADDRESS_MINUTO_OFF, minuto);
          break;
      }

      while (digitalRead(ACEPTAR)) {}
      break;
    }
    t++;
    delay(100);
  }
}

/*
   Está calcula si seencuentra dentro del horario de encendido del relay y regresa su estado actual
*/
boolean relayLoop() {
  int horaActual = RTC.now().hour();
  int minutoActual = RTC.now().minute();
  int horaOn = EEPROM.read(ADDRESS_HORA_ON);
  int minutoOn = EEPROM.read(ADDRESS_MINUTO_ON);
  int horaOff = EEPROM.read(ADDRESS_HORA_OFF);
  int minutoOff = EEPROM.read(ADDRESS_MINUTO_OFF);
  boolean modo = true;

  if (horaOff < horaOn) {
    modo = false;
  }
  else if (horaOff == horaOn && minutoOff < minutoOn) {
    modo = false;
  }


  if ( modo && ((horaActual > horaOn && horaActual < horaOff) || (horaActual == horaOn && minutoActual >= minutoOn && horaOn != horaOff) || (horaActual == horaOff && minutoActual < minutoOff && horaOn != horaOff) || (horaActual == horaOn && horaOn == horaOff && minutoActual >= minutoOn && minutoActual < minutoOff)))
  {
    return true;
  }
  else if ( !modo && ( (horaActual > horaOn) || (horaActual == horaOn && minutoActual >= minutoOn) || (horaActual < horaOff) || (horaActual == horaOff && minutoActual < minutoOff)  )) {
    return true;
  }
  else {
    return false;
  }
}


void bluetooth()
{
  if (Serial.available())
  {
    String mensajeBt = Serial.readString();
    decodificarMensajeBt(mensajeBt);
  }
}

void decodificarMensajeBt(String m)
{
  if (m.indexOf(F("SET AUTOMATIC MODE")) >= 0)
  {
    paginaActual = 0;
  }
  else if(m.indexOf(F("SET MANUAL MODE")) >= 0)
  {
    paginaActual = 3;
    if(digitalRead(RELAY))
    {
      Serial.print("RELAYTRUE");
    }
    else
    {
      Serial.print("RELAYFALSE  ");
    }
  }
  else if(m.indexOf(F("SETCONFIG")) >= 0)
  {
    byte hora_on = extraerDato(m, F("he="), F("&me="));
    byte minuto_on = extraerDato(m, F("me="), F("&ha="));
    byte hora_off = extraerDato(m, F("ha="), F("&ma="));
    byte minuto_off = extraerDato(m, F("ma="), F("ETX&"));
    EEPROM.write(ADDRESS_HORA_ON, hora_on);
    EEPROM.write(ADDRESS_MINUTO_ON, minuto_on);
    EEPROM.write(ADDRESS_HORA_OFF, hora_off);
    EEPROM.write(ADDRESS_MINUTO_OFF, minuto_off);
    Serial.print("Datos Recibidos");
  }
  else if(m.indexOf(F("CONFIGREQUEST")) >= 0)
  {
    String dataRequest = "CONFIG?he=";
    if(EEPROM.read(ADDRESS_HORA_ON) < 10){dataRequest += "0";}
    dataRequest += EEPROM.read(ADDRESS_HORA_ON);
    dataRequest += "&me=";
    if(EEPROM.read(ADDRESS_MINUTO_ON) < 10){dataRequest += "0";}
    dataRequest += EEPROM.read(ADDRESS_MINUTO_ON);
    dataRequest += "&ha=";
    if(EEPROM.read(ADDRESS_HORA_OFF) < 10){dataRequest += "0";}
    dataRequest += EEPROM.read(ADDRESS_HORA_OFF);
    dataRequest += "&ma=";
    if(EEPROM.read(ADDRESS_MINUTO_OFF) < 10){dataRequest += "0";}
    dataRequest += EEPROM.read(ADDRESS_MINUTO_OFF);
    Serial.print(dataRequest);
  }
  else if(m.indexOf(F("SETSTATUS")) >= 0)
  {
    boolean estado = extraerDato(m, F("RELAY="), F("ETX&"));
    digitalWrite(RELAY, estado);
    if(estado)
    {
      Serial.print("RELAYTRUE");
    }
    else
    {
      Serial.print("RELAYFALSE  ");
    }
  }
 }

 byte extraerDato(String mensaje, String inicio, String fin)
 {
  return mensaje.substring(mensaje.indexOf(inicio) + inicio.length(), mensaje.indexOf(fin)).toInt();
 }

 
